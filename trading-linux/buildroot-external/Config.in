## trading-linux/buildroot-external/Config.in
```kconfig
menu "Trading System Configuration"

source "$BR2_EXTERNAL_TRADING_PATH/package/Config.in"

endmenu
```

## trading-linux/buildroot-external/package/Config.in
```kconfig
source "$BR2_EXTERNAL_TRADING_PATH/package/nvidia-driver-trading/Config.in"
source "$BR2_EXTERNAL_TRADING_PATH/package/cuda-trading/Config.in"
source "$BR2_EXTERNAL_TRADING_PATH/package/xgboost/Config.in"
source "$BR2_EXTERNAL_TRADING_PATH/package/xdma/Config.in"
source "$BR2_EXTERNAL_TRADING_PATH/package/google-benchmark/Config.in"
source "$BR2_EXTERNAL_TRADING_PATH/package/librdkafka/Config.in"
source "$BR2_EXTERNAL_TRADING_PATH/package/sdl2-trading/Config.in"
source "$BR2_EXTERNAL_TRADING_PATH/package/sdl2-image-trading/Config.in"
source "$BR2_EXTERNAL_TRADING_PATH/package/sdl2-ttf-trading/Config.in"
source "$BR2_EXTERNAL_TRADING_PATH/package/meson-target/Config.in"
source "$BR2_EXTERNAL_TRADING_PATH/package/ninja-target/Config.in"
```

## trading-linux/buildroot-external/package/cuda-trading/Config.in
```kconfig
config BR2_PACKAGE_CUDA_TRADING
	bool "NVIDIA CUDA Toolkit (Trading OS custom)"
	depends on BR2_x86_64
	depends on BR2_PACKAGE_NVIDIA_DRIVER_TRADING
	help
	  NVIDIA CUDA Toolkit for GPU computing, customized for Trading OS.

	  IMPORTANT: XGBoost 3.2 only works with CUDA 13.0, NOT 13.1.
	  CUDA 13.1 has CCCL 3.1.2 which breaks XGBoost 3.x compatibility.
	  
	  REQUIRES LOCAL FILES:
	  - /work/tos/cuda-13.0 (extracted directory) OR
	  - /work/tos/cuda_13.0.0_580.65.06_linux.run (installer)

	  https://developer.nvidia.com/cuda-toolkit

if BR2_PACKAGE_CUDA_TRADING

config BR2_PACKAGE_CUDA_TRADING_VERSION
	string "CUDA version"
	default "13.0.0"
	help
	  CUDA version to install.
	  
	  CRITICAL: Must be 13.0.0 for XGBoost 3.2 compatibility.
	  Do NOT use 13.1.0 as it has breaking changes.
	  
	  Must match the local directory or installer at:
	  /work/tos/cuda-$(VERSION) or /work/tos/cuda_$(VERSION)_$(BUILD_NUMBER)_linux.run

config BR2_PACKAGE_CUDA_TRADING_BUILD_NUMBER
	string "CUDA build number"
	default "580.65.06"
	help
	  CUDA build number (e.g., 580.65.06 for CUDA 13.0.0).
	  
	  Must match the local installer filename:
	  /work/tos/cuda_$(VERSION)_$(BUILD_NUMBER)_linux.run

config BR2_PACKAGE_CUDA_TRADING_MINIMAL
	bool "Install minimal CUDA (runtime libraries only)"
	default y
	help
	  Install only runtime libraries needed for XGBoost:
	  - libcudart.so (CUDA runtime)
	  - libcublas.so (used by XGBoost)
	  - libcublasLt.so (used by XGBoost)
	  - libcurand.so (used by XGBoost)
	  
	  This reduces size from ~5GB to ~500MB.

endif
```

## trading-linux/buildroot-external/package/google-benchmark/Config.in
```kconfig
config BR2_PACKAGE_GOOGLE_BENCHMARK
	bool "google-benchmark"
	depends on BR2_INSTALL_LIBSTDCPP
	depends on BR2_USE_WCHAR
	help
	  Google Benchmark is a library to support the benchmarking
	  of functions, similar to unit tests but for performance.

	  https://github.com/google/benchmark

if BR2_PACKAGE_GOOGLE_BENCHMARK

config BR2_PACKAGE_GOOGLE_BENCHMARK_VERSION
	string "Google Benchmark version"
	default "1.8.3"
	help
	  Google Benchmark version to build.
	  
	  Latest stable version is 1.8.3 (as of 2024).
	  Can use "main" for latest development version.

endif
```

## trading-linux/buildroot-external/package/librdkafka/Config.in
```kconfig
config BR2_PACKAGE_LIBRDKAFKA
	bool "librdkafka"
	help
	  The Apache Kafka C/C++ client library.

	  librdkafka is a C library implementation of the Apache Kafka
	  protocol, providing Producer, Consumer and Admin clients.

	  https://github.com/confluentinc/librdkafka

if BR2_PACKAGE_LIBRDKAFKA

config BR2_PACKAGE_LIBRDKAFKA_SSL
	bool "Enable SSL support"
	default y
	depends on BR2_PACKAGE_OPENSSL
	help
	  Enable SSL/TLS support in librdkafka.

config BR2_PACKAGE_LIBRDKAFKA_SASL
	bool "Enable SASL support"
	default y
	depends on BR2_PACKAGE_LIBSASL2
	help
	  Enable SASL authentication support in librdkafka.

config BR2_PACKAGE_LIBRDKAFKA_ZSTD
	bool "Enable ZStd compression"
	default y
	depends on BR2_PACKAGE_ZSTD
	help
	  Enable ZStd compression support in librdkafka.

endif
```

## trading-linux/buildroot-external/package/meson-target/Config.in
```kconfig
config BR2_PACKAGE_MESON_TARGET
	bool "meson-target"
	depends on BR2_PACKAGE_PYTHON3
	select BR2_PACKAGE_ZLIB
	select BR2_PACKAGE_PYTHON3_ZLIB
	help
	  Meson build system for target.
	  
	  Meson is an open source build system meant to be both extremely
	  fast, and, even more importantly, as user friendly as possible.
	  
	  This package installs meson on the target system, allowing you
	  to build software directly on the target.
	  
	  https://mesonbuild.com/

comment "meson-target needs python3"
	depends on !BR2_PACKAGE_PYTHON3
```

## trading-linux/buildroot-external/package/ninja-target/Config.in
```kconfig
config BR2_PACKAGE_NINJA_TARGET
	bool "ninja-target"
	help
	  Ninja build system for target.
	  
	  Ninja is a small build system with a focus on speed. It differs
	  from other build systems in two major respects: it is designed to
	  have its input files generated by a higher-level build system, and
	  it is designed to run builds as fast as possible.
	  
	  This package installs ninja on the target system, required by meson
	  and other build systems.
	  
	  https://ninja-build.org/
```

## trading-linux/buildroot-external/package/nvidia-driver-trading/Config.in
```kconfig
config BR2_PACKAGE_NVIDIA_DRIVER_TRADING
	bool "NVIDIA driver (Trading OS custom - open-source + proprietary)"
	depends on BR2_LINUX_KERNEL
	depends on BR2_x86_64
	help
	  NVIDIA graphics driver for GPU acceleration, customized for Trading OS.
	  
	  IMPORTANT: For RTX 5090 (Blackwell), requires BOTH:
	  1. Open-source kernel modules (from GitHub) - REQUIRED for RTX 5090
	  2. Proprietary user-space libraries (from NVIDIA installer) - Still needed
	  
	  This package builds open-source kernel modules and installs
	  user-space libraries from the proprietary installer.
	  
	  REQUIRES LOCAL FILES:
	  - /work/tos/nvidia_driver-linux-x86_64-590.48.01-archive (or .tar.xz)
	  - /work/tos/open-gpu-kernel-modules (git repository)

	  https://www.nvidia.com/Download/index.aspx
	  https://github.com/NVIDIA/open-gpu-kernel-modules

if BR2_PACKAGE_NVIDIA_DRIVER_TRADING

config BR2_PACKAGE_NVIDIA_DRIVER_TRADING_VERSION
	string "NVIDIA driver version"
	default "590.48.01"
	help
	  NVIDIA driver version to build.
	  Must match your GPU model and kernel version.
	  
	  Must match the local archive at:
	  /work/tos/nvidia_driver-linux-x86_64-$(VERSION)-archive

	  Examples: 590.48.01, 580.95.05, 600.xx.xx

endif
```

## trading-linux/buildroot-external/package/sdl2-image-trading/Config.in
```kconfig
config BR2_PACKAGE_SDL2_IMAGE_TRADING
	bool "SDL2_image (Trading OS custom - from local source)"
	depends on BR2_PACKAGE_SDL2_TRADING
	help
	  SDL2_image library for loading images (PNG, JPEG, etc.)
	  
	  This custom build ensures compatibility with sdl2-trading package.
	  Built from local source at /work/tos/SDL_image.
	  
	  REQUIRES LOCAL SOURCE:
	  - /work/tos/SDL_image (SDL2_image source directory)
	  
	  https://github.com/libsdl-org/SDL_image
```

## trading-linux/buildroot-external/package/sdl2-trading/Config.in
```kconfig
config BR2_PACKAGE_SDL2_TRADING
	bool "SDL2 (Trading OS custom - from local source)"
	select BR2_PACKAGE_LIBDRM
	# NOTE: libgbm is NOT selected - we use NVIDIA's GBM, not Mesa's
	# Mesa's software EGL/GBM conflicts with NVIDIA's hardware-accelerated implementation
	help
	  SDL2 library built from local source at /work/tos/SDL.
	  
	  This custom build ensures proper DRM/KMS support for NVIDIA drivers.
	  Built with:
	  - --enable-video-kmsdrm (DRM/KMS video driver - CRITICAL for NVIDIA)
	  - --enable-video-dummy (fallback driver)
	  - --disable-video-x11 (no X11)
	  - --disable-video-wayland (no Wayland)
	  - --disable-video-opengl (no OpenGL, use software rendering)
	  
	  REQUIRES LOCAL SOURCE:
	  - /work/tos/SDL (SDL2 source directory)
	  
	  Note: SDL2_image and SDL2_ttf are provided by Buildroot's standard
	  packages and will work with this custom SDL2 build.
	  
	  https://www.libsdl.org/
```

## trading-linux/buildroot-external/package/sdl2-ttf-trading/Config.in
```kconfig
config BR2_PACKAGE_SDL2_TTF_TRADING
	bool "SDL2_ttf (Trading OS custom - from local source)"
	depends on BR2_PACKAGE_SDL2_TRADING
	help
	  SDL2_ttf library for rendering TrueType fonts
	  
	  This custom build ensures compatibility with sdl2-trading package.
	  Built from local source at /work/tos/SDL_ttf.
	  
	  REQUIRES LOCAL SOURCE:
	  - /work/tos/SDL_ttf (SDL2_ttf source directory)
	  
	  https://github.com/libsdl-org/SDL_ttf
```

## trading-linux/buildroot-external/package/xdma/Config.in
```kconfig
config BR2_PACKAGE_XDMA
	bool "Xilinx XDMA driver"
	depends on BR2_LINUX_KERNEL
	help
	  Xilinx DMA (XDMA) driver for PCIe-based FPGA communication.
	  
	  This driver enables high-speed DMA transfers between the host
	  and FPGA over PCIe Gen2 x4.
	  
	  REQUIRES LOCAL FILES:
	  - /work/tos/dma_ip_drivers (git repository or extracted directory)

	  https://github.com/Xilinx/dma_ip_drivers

if BR2_PACKAGE_XDMA

config BR2_PACKAGE_XDMA_VERSION
	string "XDMA driver version"
	default "2023.1"
	help
	  XDMA driver version/tag (for reference only, uses local files).

endif
```

## trading-linux/buildroot-external/package/xgboost/Config.in
```kconfig
config BR2_PACKAGE_XGBOOST
	bool "XGBoost machine learning library"
	depends on BR2_PACKAGE_CUDA_TRADING
	depends on BR2_INSTALL_LIBSTDCPP
	help
	  XGBoost is an optimized distributed gradient boosting library.

	  IMPORTANT: XGBoost 3.2 only works with CUDA 13.0, NOT 13.1.
	  CUDA 13.1 has CCCL 3.1.2 which breaks XGBoost 3.x compatibility.
	  
	  REQUIRES LOCAL FILES:
	  - /work/tos/xgboost (git repository)

	  https://xgboost.readthedocs.io/

if BR2_PACKAGE_XGBOOST

config BR2_PACKAGE_XGBOOST_VERSION
	string "XGBoost version"
	default "3.2.0"
	help
	  XGBoost version to build.
	  
	  Use 3.2.0 (main branch) for latest features and CUDA 13.0 support.
	  Stable release is 3.1.2, but 3.2.0-dev on main has better CUDA support.
	  
	  Must match the local git repository at /work/tos/xgboost

config BR2_PACKAGE_XGBOOST_USE_CUDA
	bool "Build with CUDA support"
	default y
	depends on BR2_PACKAGE_CUDA_TRADING
	help
	  Build XGBoost with CUDA/GPU acceleration support.
	  
	  Requires CUDA 13.0 (not 13.1) for XGBoost 3.2 compatibility.

config BR2_PACKAGE_XGBOOST_CUDA_ARCH
	string "CUDA architecture"
	default "90"
	depends on BR2_PACKAGE_XGBOOST_USE_CUDA
	help
	  CUDA compute capability architecture.
	  
	  RTX 5090 (Blackwell) = sm_100 or sm_90 for compatibility.
	  Use "90" for RTX 5090 or "100" if available.

endif
```
